## buildroot/package/extension_spotify/Config.in
```kconfig
config BR2_PACKAGE_EXTENSION_SPOTIFY
	bool "Spotify"

        depends on BR2_PACKAGE_EXTENSIONS
```

## buildroot/package/extensions/Config.in
```kconfig
config BR2_PACKAGE_EXTENSIONS
	bool "extensions"
	help
	  A simple framework to add extensions to HiFiBerryOS

	select BR2_PACKAGE_GIT
```

## buildroot/package/hattools/Config.in
```kconfig
config BR2_PACKAGE_HATTOOLS
	bool "hattools"
        help
          tools to read/write to HAT EEPROM
```

## buildroot/package/hifiberry-all/Config.in
```kconfig
config BR2_PACKAGE_HIFIBERRY_ALL
	bool "hifiberry-all"
        help
	  select all packages required for HiFiBerryOS
	select BR2_PACKAGE_OPENSSH

	select BR2_PACKAGE_HIFIBERRY_BASE
	select BR2_PACKAGE_HIFIBERRY_USERS
	select BR2_PACKAGE_HIFIBERRY_TOOLS
	select BR2_PACKAGE_HIFIBERRY_UPDATER
	select BR2_PACKAGE_COPY_OVERLAYS
	select BR2_PACKAGE_CONFIGTXT
	select BR2_PACKAGE_CONFIGTXT_QUIET
	# select BR2_PACKAGE_CONFIGTXT_EEPROM
	select BR2_PACKAGE_RASPI_WIFI
	select BR2_PACKAGE_HIFIBERRY_POWERCONTROLLER
	select BR2_PACKAGE_PIGPIOD_SYSTEMD
	select BR2_PACKAGE_ENABLE_ARM7
	select BR2_PACKAGE_DISABLE_SAMBA
	select BR2_PACKAGE_HATTOOLS
	select BR2_PACKAGE_EXTENSIONS

	select BR2_PACKAGE_BEOCREATE
	# select BR2_PACKAGE_ENABLE_VC4KMS
	select BR2_PACKAGE_HIFIBERRY_PSPLASH
	select BR2_PACKAGE_HIFIBERRY_WESTON
	select BR2_PACKAGE_BEOCREATE_MUSIC
	select BR2_PACKAGE_DSP_PROMO

        #select BR2_PACKAGE_LMSMPRIS
        #select BR2_PACKAGE_RAAT
        #select BR2_PACKAGE_HIFIBERRY_SQUEEZELITE 
	# select BR2_PACKAGE_HIFIBERRY_SHAIRPORT_AIRPLAY2
        select BR2_PACKAGE_HIFIBERRY_BLUEZALSA
        select BR2_PACKAGE_HIFIBERRY_UPMPDCLI
        # select BR2_PACKAGE_NQPTP
        # select BR2_PACKAGE_HIFIBERRY_SHAIRPORT
        select BR2_PACKAGE_HIFIBERRY_MPD
        #select BR2_PACKAGE_HIFIBERRY_YMPD
        select BR2_PACKAGE_HIFIBERRY_ALSALOOP
        select BR2_PACKAGE_BTSPEAKER
        select BR2_PACKAGE_MPRIS_PROXY
        select BR2_PACKAGE_SNAPCAST
        select BR2_PACKAGE_VOLLIBRESPOT
        select BR2_PACKAGE_WEBRADIO
	select BR2_PACKAGE_SNAPCASTMPRIS
	select BR2_PACKAGE_DLNAMPRIS

        select BR2_PACKAGE_HIFIBERRY_DOCKER 
        select BR2_PACKAGE_BRUTEFIR
        select BR2_PACKAGE_DSPTOOLKIT
	select BR2_PACKAGE_DSPPROFILES
        select BR2_PACKAGE_AUDIOCONTROL2 
        select BR2_PACKAGE_MUSICFILETOOLS
        select BR2_PACKAGE_HIFIBERRY_MEASUREMENTS 
        select BR2_PACKAGE_SMBTOOLS
        select BR2_PACKAGE_HIFIBERRY_AUTOMOUNT 
        select BR2_PACKAGE_IR_REMOTE 

	select BR2_PACKAGE_PIGPIO
```

## buildroot/package/hifiberry-alsaloop/Config.in
```kconfig
config BR2_PACKAGE_HIFIBERRY_ALSALOOP
	bool "hifiberry-alsaloop"
        help
	  Run alsaloop as a background daemon
        depends on BR2_PACKAGE_HIFIBERRY_BASE
	select BR2_PACKAGE_ALSA_UTILS_ALSALOOP
```
