## buildroot/Config.in
```kconfig
comment "Base packages"
source "$BR2_EXTERNAL_HIFIBERRY_PATH/package/hifiberry-base/Config.in"
source "$BR2_EXTERNAL_HIFIBERRY_PATH/package/hifiberry-users/Config.in"
source "$BR2_EXTERNAL_HIFIBERRY_PATH/package/hifiberry-tools/Config.in"
source "$BR2_EXTERNAL_HIFIBERRY_PATH/package/hifiberry-updater/Config.in"
source "$BR2_EXTERNAL_HIFIBERRY_PATH/package/copy-overlays/Config.in"
source "$BR2_EXTERNAL_HIFIBERRY_PATH/package/alsa-plugins/Config.in"
source "$BR2_EXTERNAL_HIFIBERRY_PATH/package/alsa-eq/Config.in"
source "$BR2_EXTERNAL_HIFIBERRY_PATH/package/configtxt/Config.in"
source "$BR2_EXTERNAL_HIFIBERRY_PATH/package/raspi-wifi/Config.in"
source "$BR2_EXTERNAL_HIFIBERRY_PATH/package/hifiberry-systemd/Config.in"
source "$BR2_EXTERNAL_HIFIBERRY_PATH/package/hifiberry-powercontroller/Config.in"
source "$BR2_EXTERNAL_HIFIBERRY_PATH/package/hifiberry-watchdog/Config.in"
source "$BR2_EXTERNAL_HIFIBERRY_PATH/package/disable-samba/Config.in"
source "$BR2_EXTERNAL_HIFIBERRY_PATH/package/enable-arm7/Config.in"
source "$BR2_EXTERNAL_HIFIBERRY_PATH/package/pigpiod-systemd/Config.in"

comment "Players"
source "$BR2_EXTERNAL_HIFIBERRY_PATH/package/lmsmpris/Config.in"
source "$BR2_EXTERNAL_HIFIBERRY_PATH/package/spotifyd/Config.in"
source "$BR2_EXTERNAL_HIFIBERRY_PATH/package/raat/Config.in"
source "$BR2_EXTERNAL_HIFIBERRY_PATH/package/hifiberry-squeezelite/Config.in"
source "$BR2_EXTERNAL_HIFIBERRY_PATH/package/hifiberry-bluezalsa/Config.in"
source "$BR2_EXTERNAL_HIFIBERRY_PATH/package/hifiberry-upmpdcli/Config.in"
source "$BR2_EXTERNAL_HIFIBERRY_PATH/package/hifiberry-gmrender/Config.in"
source "$BR2_EXTERNAL_HIFIBERRY_PATH/package/hifiberry-gstreamer/Config.in"
source "$BR2_EXTERNAL_HIFIBERRY_PATH/package/dlnampris/Config.in"
source "$BR2_EXTERNAL_HIFIBERRY_PATH/package/nqptp/Config.in"
source "$BR2_EXTERNAL_HIFIBERRY_PATH/package/hifiberry-shairport/Config.in"
source "$BR2_EXTERNAL_HIFIBERRY_PATH/package/librespot/Config.in"
#source "$BR2_EXTERNAL_HIFIBERRY_PATH/package/mopidy/Config.in"
#source "$BR2_EXTERNAL_HIFIBERRY_PATH/package/mopidy-local/Config.in"
#source "$BR2_EXTERNAL_HIFIBERRY_PATH/package/mopidy-alsamixer/Config.in"
#source "$BR2_EXTERNAL_HIFIBERRY_PATH/package/mopidy-gmusic/Config.in"
#source "$BR2_EXTERNAL_HIFIBERRY_PATH/package/mopidy-iris/Config.in"
#source "$BR2_EXTERNAL_HIFIBERRY_PATH/package/mopidy-mpd/Config.in"
#source "$BR2_EXTERNAL_HIFIBERRY_PATH/package/mopidy-mpris/Config.in"
#source "$BR2_EXTERNAL_HIFIBERRY_PATH/package/mopidy-musicbox-webclient/Config.in"
#source "$BR2_EXTERNAL_HIFIBERRY_PATH/package/mopidy-radionet/Config.in"
#source "$BR2_EXTERNAL_HIFIBERRY_PATH/package/mopidy-soundcloud/Config.in"
#source "$BR2_EXTERNAL_HIFIBERRY_PATH/package/mopidy-youtube/Config.in"
source "$BR2_EXTERNAL_HIFIBERRY_PATH/package/hifiberry-mpd/Config.in"
source "$BR2_EXTERNAL_HIFIBERRY_PATH/package/hifiberry-ympd/Config.in"
source "$BR2_EXTERNAL_HIFIBERRY_PATH/package/mpd-mpris/Config.in"
source "$BR2_EXTERNAL_HIFIBERRY_PATH/package/hifiberry-alsaloop/Config.in"
source "$BR2_EXTERNAL_HIFIBERRY_PATH/package/btspeaker/Config.in"
source "$BR2_EXTERNAL_HIFIBERRY_PATH/package/mpris-proxy/Config.in"
source "$BR2_EXTERNAL_HIFIBERRY_PATH/package/snapcast/Config.in"
source "$BR2_EXTERNAL_HIFIBERRY_PATH/package/snapcastmpris/Config.in"
source "$BR2_EXTERNAL_HIFIBERRY_PATH/package/vollibrespot/Config.in"
source "$BR2_EXTERNAL_HIFIBERRY_PATH/package/webradio/Config.in"

comment "Backend applications"
source "$BR2_EXTERNAL_HIFIBERRY_PATH/package/hifiberry-docker/Config.in"
source "$BR2_EXTERNAL_HIFIBERRY_PATH/package/brutefir/Config.in"
source "$BR2_EXTERNAL_HIFIBERRY_PATH/package/dsptoolkit/Config.in"
source "$BR2_EXTERNAL_HIFIBERRY_PATH/package/dspprofiles/Config.in"
source "$BR2_EXTERNAL_HIFIBERRY_PATH/package/audiocontrol2/Config.in"
source "$BR2_EXTERNAL_HIFIBERRY_PATH/package/musicfiletools/Config.in"
source "$BR2_EXTERNAL_HIFIBERRY_PATH/package/hifiberry-postgres/Config.in"
source "$BR2_EXTERNAL_HIFIBERRY_PATH/package/hifiberry-measurements/Config.in"
source "$BR2_EXTERNAL_HIFIBERRY_PATH/package/hifiberry-analytics/Config.in"
source "$BR2_EXTERNAL_HIFIBERRY_PATH/package/smbtools/Config.in"
source "$BR2_EXTERNAL_HIFIBERRY_PATH/package/hifiberry-automount/Config.in"
#source "$BR2_EXTERNAL_HIFIBERRY_PATH/package/wisa-scripts/Config.in"

comment "GUI"
source "$BR2_EXTERNAL_HIFIBERRY_PATH/package/beocreate/Config.in"
source "$BR2_EXTERNAL_HIFIBERRY_PATH/package/beocreate-music/Config.in"
source "$BR2_EXTERNAL_HIFIBERRY_PATH/package/dsp-promo/Config.in"
source "$BR2_EXTERNAL_HIFIBERRY_PATH/package/enable-vc4kms/Config.in"
source "$BR2_EXTERNAL_HIFIBERRY_PATH/package/hifiberry-psplash/Config.in"
source "$BR2_EXTERNAL_HIFIBERRY_PATH/package/hifiberry-localbrowser/Config.in"


comment "Libraries"
#source "$BR2_EXTERNAL_HIFIBERRY_PATH/package/caps/Config.in"

comment "Python modules"
source "$BR2_EXTERNAL_HIFIBERRY_PATH/package/python-appdirs/Config.in"
source "$BR2_EXTERNAL_HIFIBERRY_PATH/package/python-blinker/Config.in"
source "$BR2_EXTERNAL_HIFIBERRY_PATH/package/python-bottle-websocket/Config.in"
source "$BR2_EXTERNAL_HIFIBERRY_PATH/package/python-bs4/Config.in"
source "$BR2_EXTERNAL_HIFIBERRY_PATH/package/python-cachetools/Config.in"
source "$BR2_EXTERNAL_HIFIBERRY_PATH/package/python-cythont/Config.in"
source "$BR2_EXTERNAL_HIFIBERRY_PATH/package/python-expiringdict/Config.in"
source "$BR2_EXTERNAL_HIFIBERRY_PATH/package/python-gevent/Config.in"
source "$BR2_EXTERNAL_HIFIBERRY_PATH/package/python-gevent-websocket/Config.in"
source "$BR2_EXTERNAL_HIFIBERRY_PATH/package/python-gmusicapi/Config.in"
source "$BR2_EXTERNAL_HIFIBERRY_PATH/package/python-gpsoauth/Config.in"
source "$BR2_EXTERNAL_HIFIBERRY_PATH/package/python-gstreamer-player/Config.in"
source "$BR2_EXTERNAL_HIFIBERRY_PATH/package/python-hidapi/Config.in"
source "$BR2_EXTERNAL_HIFIBERRY_PATH/package/python-keyboard/Config.in"
source "$BR2_EXTERNAL_HIFIBERRY_PATH/package/python-levenshtein/Config.in"
source "$BR2_EXTERNAL_HIFIBERRY_PATH/package/python-mechanicalsoup/Config.in"
source "$BR2_EXTERNAL_HIFIBERRY_PATH/package/python-mock/Config.in"
source "$BR2_EXTERNAL_HIFIBERRY_PATH/package/python-mpd2/Config.in"
source "$BR2_EXTERNAL_HIFIBERRY_PATH/package/python-musicbrainz-ngs/Config.in"
source "$BR2_EXTERNAL_HIFIBERRY_PATH/package/python-oauth2client/Config.in"
source "$BR2_EXTERNAL_HIFIBERRY_PATH/package/python-pg8000/Config.in"
source "$BR2_EXTERNAL_HIFIBERRY_PATH/package/python-proboscis/Config.in"
source "$BR2_EXTERNAL_HIFIBERRY_PATH/package/python-pydbus/Config.in"
source "$BR2_EXTERNAL_HIFIBERRY_PATH/package/python-pyedbglib/Config.in"
source "$BR2_EXTERNAL_HIFIBERRY_PATH/package/python-pygobject/Config.in"
source "$BR2_EXTERNAL_HIFIBERRY_PATH/package/python-pykka/Config.in"
source "$BR2_EXTERNAL_HIFIBERRY_PATH/package/python-pyky040/Config.in"
source "$BR2_EXTERNAL_HIFIBERRY_PATH/package/python-pylast/Config.in"
source "$BR2_EXTERNAL_HIFIBERRY_PATH/package/python-pyserial/Config.in"
source "$BR2_EXTERNAL_HIFIBERRY_PATH/package/python-pymcuprog/Config.in"
source "$BR2_EXTERNAL_HIFIBERRY_PATH/package/python-pyupdi/Config.in"
source "$BR2_EXTERNAL_HIFIBERRY_PATH/package/python-scramp/Config.in"
source "$BR2_EXTERNAL_HIFIBERRY_PATH/package/python-tzupdate/Config.in"
source "$BR2_EXTERNAL_HIFIBERRY_PATH/package/python-uritools/Config.in"
source "$BR2_EXTERNAL_HIFIBERRY_PATH/package/python-usagedata/Config.in"
source "$BR2_EXTERNAL_HIFIBERRY_PATH/package/python-validictory/Config.in"
source "$BR2_EXTERNAL_HIFIBERRY_PATH/package/python-youtube-dl/Config.in"
#source "$BR2_EXTERNAL_HIFIBERRY_PATH/package/python-wisa/Config.in"

comment "Test tools"
source "$BR2_EXTERNAL_HIFIBERRY_PATH/package/hifiberry-test/Config.in"
```

## buildroot/configs/raspberypi3_defconfig
```kconfig
BR2_arm=y
BR2_cortex_a53=y
BR2_ARM_FPU_NEON_VFPV4=y
BR2_CCACHE=y
BR2_TOOLCHAIN_BUILDROOT_GLIBC=y
BR2_PACKAGE_HOST_LINUX_HEADERS_CUSTOM_4_14=y
BR2_TOOLCHAIN_BUILDROOT_CXX=y
BR2_TARGET_GENERIC_HOSTNAME="hifiberry"
BR2_TARGET_GENERIC_ISSUE="Welcome to HiFiBerryOS"
BR2_TARGET_GENERIC_PASSWD_SHA512=y
BR2_ROOTFS_DEVICE_CREATION_DYNAMIC_EUDEV=y
BR2_TARGET_GENERIC_ROOT_PASSWD="hifiberry"
BR2_SYSTEM_BIN_SH_BASH=y
BR2_SYSTEM_DHCP="eth0"
BR2_ROOTFS_USERS_TABLES="../hifiberry-os/buildroot/configs/users"
BR2_ROOTFS_OVERLAY="../hifiberry-os/buildroot/board/raspberrypi3/overlay"
BR2_ROOTFS_POST_BUILD_SCRIPT="board/raspberrypi3/post-build.sh"
BR2_ROOTFS_POST_IMAGE_SCRIPT="board/raspberrypi3/post-image.sh"
BR2_ROOTFS_POST_SCRIPT_ARGS="--add-pi3-miniuart-bt-overlay"
BR2_LINUX_KERNEL=y
BR2_LINUX_KERNEL_CUSTOM_TARBALL=y
BR2_LINUX_KERNEL_CUSTOM_TARBALL_LOCATION="$(call github,raspberrypi,linux,865ddc1393f558198e7e7ce70928ff2e49c4f7f6)/linux-865ddc1393f558198e7e7ce70928ff2e49c4f7f6.tar.gz"
BR2_LINUX_KERNEL_DEFCONFIG="bcm2709"
BR2_LINUX_KERNEL_DTS_SUPPORT=y
BR2_LINUX_KERNEL_INTREE_DTS_NAME="bcm2710-rpi-3-b bcm2710-rpi-3-b-plus bcm2710-rpi-cm3"
BR2_PACKAGE_BUSYBOX_SHOW_OTHERS=y
BR2_PACKAGE_BUSYBOX_INDIVIDUAL_BINARIES=y
BR2_PACKAGE_ALSA_UTILS_AMIXER=y
BR2_PACKAGE_ALSA_UTILS_APLAY=y
BR2_PACKAGE_SOX=y
BR2_PACKAGE_RPI_FIRMWARE=y
BR2_PACKAGE_PYTHON3=y
BR2_PACKAGE_OPENSSH=y
BR2_PACKAGE_SHAIRPORT_SYNC=y
BR2_PACKAGE_SHAIRPORT_SYNC_LIBSOXR=y
BR2_TARGET_ROOTFS_EXT2=y
BR2_TARGET_ROOTFS_EXT2_4=y
BR2_TARGET_ROOTFS_EXT2_SIZE="150M"
# BR2_TARGET_ROOTFS_TAR is not set
BR2_PACKAGE_HOST_DOSFSTOOLS=y
BR2_PACKAGE_HOST_GENIMAGE=y
BR2_PACKAGE_HOST_MTOOLS=y
BR2_PACKAGE_HIFIBERRY_BASE=y
BR2_PACKAGE_HIFIBERRY_TOOLS=y
BR2_PACKAGE_DSPTOOLKIT=y
BR2_PACKAGE_SPOTIFYD=y
BR2_PACKAGE_CONFIGTXT=y
```

## buildroot/package/alsa-eq/Config.in
```kconfig
config BR2_PACKAGE_ALSA_EQ
	bool "alsa-eq"
	depends on BR2_PACKAGE_ALSA_LIB
	help
	  ALSA EQ - an equalizer plugin for ALSA

	  https://thedigitalmachine.net/alsaequal.html
	select BR2_PACKAGE_CAPS
```

## buildroot/package/audiocontrol/Config.in
```kconfig
config BR2_PACKAGE_AUDIOCONTROL
	bool "audiocontrol"
        help
	  Audiocontrol is a small server that controls volume and playback of 
          multiple audio player backends
        depends on BR2_PACKAGE_PYTHON3
        depends on BR2_PACKAGE_HIFIBERRY_BASE
        select BR2_PACKAGE_PYTHON_XMLTODICT
        select BR2_PACKAGE_PYTHON_BOTTLE
        select BR2_PACKAGE_PYTHON_ZEROCONF
        select BR2_PACKAGE_PYTHON_ALSAAUDIO
	select BR2_PACKAGE_PYTHON_KEYBOARD
	select BR2_PACKAGE_PYTHON_NUIMO
	select BR2_PACKAGE_PYTHON_LMNOTIFY
```

## buildroot/package/audiocontrol2/Config.in
```kconfig
config BR2_PACKAGE_AUDIOCONTROL2
	bool "audiocontrol2"
        help
	  "Software that managed multiple concurrent audio players"
        select BR2_PACKAGE_DBUS
	select BR2_PACKAGE_DBUS_PYTHON
        select BR2_PACKAGE_PYTHON_PYLAST
        select BR2_PACKAGE_PYTHON_BOTTLE
	select BR2_PACKAGE_PYTHON_KEYBOARD
        select BR2_PACKAGE_KBD
 	select BR2_PACKAGE_PYTHON3_ZLIB
	select BR2_PACKAGE_PYTHON_CERTIFI
	select BR2_PACKAGE_PYTHON_CHARDET
	select BR2_PACKAGE_PYTHON_IDNA
	select BR2_PACKAGE_PYTHON_REQUEST
	select BR2_PACKAGE_PYTHON_SETUPTOOLS
	select BR2_PACKAGE_PYTHON_URLLIB3
	select BR2_PACKAGE_PYTHON_KEYBOARD
        select BR2_PACKAGE_PYTHON_MUSICBRAINZ_NGS
	select BR2_PACKAGE_PYTHON_LEVENSHTEIN
	select BR2_PACKAGE_PYTHON_REQUESTS
	select BR2_PACKAGE_PYTHON_EXPIRINGDICT
	select BR2_PACKAGE_PYTHON_PYKY040
	select BR2_PACKAGE_PYTHON_PYGOBJECT
```

## buildroot/package/base/Config.in
```kconfig
config BR2_PACKAGE_HIFIBERRY_BASE
	bool "hifiberry_base"
        help
          install base ALSA dependencies
        select BR2_PACKAGE_ALSA_UTILS
```

## buildroot/package/beocreate-music/Config.in
```kconfig
config BR2_PACKAGE_BEOCREATE_MUSIC
	bool "music extension for Beocreate"
        help
	  User interface to control playback of local music libraries
        depends on BR2_PACKAGE_HIFIBERRY_BASE
        depends on BR2_PACKAGE_BEOCREATE
	select BR2_PACKAGE_LIBCURL
	select BR2_PACKAGE_LIBCURL_CURL
	select BR2_PACKAGE_MPD_MPC
```

## buildroot/package/beocreate/Config.in
```kconfig
config BR2_PACKAGE_BEOCREATE
	bool "beocreate"
        help
	  "Beocreate server and web interface"
	select BR2_PACKAGE_BZIP2 # required for Node.JS
	select BR2_PACKAGE_NODEJS
	select BR2_PACKAGE_NODEJS_NPM
	select BR2_PACKAGE_LIBUSB
```

## buildroot/package/bootfiles64/Config.in
```kconfig
config BR2_PACKAGE_BOOTFILES64
	bool "bootfiles64"
        help
	  "64bit boot files"
        select BR2_PACKAGE_BOOTFILES64
```

## buildroot/package/brutefir/Config.in
```kconfig
# from https://github.com/badaix/snapos

config BR2_PACKAGE_BRUTEFIR
	bool "Brutefir"
	help
        brutefir
    select BR2_PACKAGE_FFTW
    select BR2_PACKAGE_FFTW_DOUBLE
    select BR2_PACKAGE_FFTW_SINGLE
```

## buildroot/package/btspeaker/Config.in
```kconfig
config BR2_PACKAGE_BTSPEAKER
	bool "btspeaker"
        help
	  A Bluetooth speaker client
	depends on BR2_PACKAGE_HIFIBERRY_BASE
	select BR2_PACKAGE_PYTHON_GOBJECT
        select BR2_PACKAGE_HIFIBERRY_BLUEZALSA
	select BR2_PACKAGE_UTIL_LINUX_LIBMOUNT
	select BR2_PACKAGE_BLUEZ5_UTILS
	select BR2_PACKAGE_BLUEZ5_UTILS_CLIENT
	select BR2_PACKAGE_BLUEZ5_UTILS_DEPRECATED
	select BR2_PACKAGE_BLUEZ_TOOLS
	select BR2_PACKAGE_DBUS
	select BR2_PACKAGE_LIBGLIB2
        select BR2_PACKAGE_DBUS_PYTHON
	select BR2_PACKAGE_FDK_AAC
	select BR2_PACKAGE_BRCMFMAC_SDIO_FIRMWARE_RPI
	select BR2_PACKAGE_BRCMFMAC_SDIO_FIRMWARE_RPI_BT
```

## buildroot/package/configtxt/Config.in
```kconfig
config BR2_PACKAGE_CONFIGTXT
	bool "configtxt"
        help
          add I2C and SPI to config.txt
	depends on BR2_PACKAGE_RPI_FIRMWARE

config BR2_PACKAGE_CONFIGTXT_QUIET
        bool "quiet boot mode"
        help
          disable all boot messages to screen
        depends on BR2_PACKAGE_CONFIGTXT

config BR2_PACKAGE_CONFIGTXT_EEPROM
        bool "force_eeprom_read workaround"
        help
          set eeprom_foirce_read=0
        depends on BR2_PACKAGE_CONFIGTXT
```

## buildroot/package/copy-overlays/Config.in
```kconfig
config BR2_PACKAGE_COPY_OVERLAYS
	bool "copy overlays"
        help
	  "copy device tree binaries to overlays directory"

	select BR2_PACKAGE_PIVERSION
```

## buildroot/package/disable-samba/Config.in
```kconfig
config BR2_PACKAGE_DISABLE_SAMBA
	bool "disable-samba"
        help
          do not start smbd
	depends on BR2_PACKAGE_SAMBA4
```

## buildroot/package/dlnampris/Config.in
```kconfig
config BR2_PACKAGE_DLNAMPRIS
	bool "dlnampris"
        help
	  "MPRIS interface for DLNA server (gmrender)"
        select BR2_PACKAGE_DBUS
	select BR2_PACKAGE_DBUS_PYTHON
        select BR2_PACKAGE_PYTHON_NETIFACES
```

## buildroot/package/dsp-promo/Config.in
```kconfig
config BR2_PACKAGE_DSP_PROMO
	bool "dsp-promo"
        help
	  Promote DSP features in sound menu
        depends on BR2_PACKAGE_HIFIBERRY_BASE
        depends on BR2_PACKAGE_BEOCREATE
```

## buildroot/package/dspprofiles/Config.in
```kconfig
config BR2_PACKAGE_DSPPROFILES
	bool "DSP profiles"
        help
	  Some DSP profiles to be deployed on DAC+ DSP and/or Beocreate 4 channel amplifier
        depends on BR2_PACKAGE_DSPTOOLKIT
```

## buildroot/package/dsptoolkit/Config.in
```kconfig
config BR2_PACKAGE_DSPTOOLKIT
	bool "dsptoolkit"
        help
	  DSPToolkit is a set of tools to work with HiFiBerry
          DSP boards
        depends on BR2_PACKAGE_PYTHON3
        depends on BR2_PACKAGE_HIFIBERRY_BASE
        select BR2_PACKAGE_PYTHON_XMLTODICT
        select BR2_PACKAGE_PYTHON_SPIDEV
        select BR2_PACKAGE_PYTHON_ZEROCONF
        select BR2_PACKAGE_PYTHON_ALSAAUDIO
	select BR2_PACKAGE_OPENSSL
	select BR2_PACKAGE_PYTHON3_SSL
	select BR2_PACKAGE_CA_CERTIFICATES
```

## buildroot/package/enable-arm7/Config.in
```kconfig
config BR2_PACKAGE_ENABLE_ARM7
	bool "enable ARM7 feature"
        help
	  "creates /etc/features/arm7"
```

## buildroot/package/enable-vc4kms/Config.in
```kconfig
config BR2_PACKAGE_ENABLE_VC4KMS
	bool "enable VC4 KMS"
        help
	  "enable VC4 KMS driver in /boot/config.txt"
	select BR2_PACKAGE_RPI_FIRMWARE
```
