## buildroot/package/python-bs4/Config.in
```kconfig
config BR2_PACKAGE_PYTHON_BS4
	bool "python-bs4"
	select BR2_PACKAGE_PYTHON_BEAUTIFULSOUP4 # runtime
	help
	  Dummy package for Beautiful Soup.

	  https://pypi.python.org/pypi/beautifulsoup4
```

## buildroot/package/python-cachetools/Config.in
```kconfig
config BR2_PACKAGE_PYTHON_CACHETOOLS
	bool "python-cachetools"
	help
		Python cachetools
```

## buildroot/package/python-cythont/Config.in
```kconfig
config BR2_PACKAGE_PYTHON_CYTHONT
	bool "python-cythont"
	help
	  The Cython compiler for writing C extensions for the Python
	  language - target installation

	  http://cython.org/
```

## buildroot/package/python-discid/Config.in
```kconfig
config BR2_PACKAGE_PYTHON_DISCID
	bool "python-discid"
	select BR2_PACKAGE_LIBDISCID
	help
	  Python-discid implements Python bindings for MusicBrainz Libdiscid.

	  https://github.com/JonnyJD/python-discid
```

## buildroot/package/python-expiringdict/Config.in
```kconfig
config BR2_PACKAGE_PYTHON_EXPIRINGDICT
	bool "python-expiringdict"
	help
	  Dictionary with auto-expiring values for caching purposes.

	  https://github.com/mailgun/expiringdict
```

## buildroot/package/python-gevent-websocket/Config.in
```kconfig
config BR2_PACKAGE_PYTHON_GEVENT_WEBSOCKET
	bool "python-gevent-websocket"
	select BR2_PACKAGE_PYTHON_G # runtime
	select BR2_PACKAGE_PYTHON_E # runtime
	select BR2_PACKAGE_PYTHON_V # runtime
	select BR2_PACKAGE_PYTHON_E # runtime
	select BR2_PACKAGE_PYTHON_N # runtime
	select BR2_PACKAGE_PYTHON_T # runtime
	help
	  Websocket handler for the gevent pywsgi server, a Python
	  network library.

	  https://www.gitlab.com/noppo/gevent-websocket
```

## buildroot/package/python-gevent/Config.in
```kconfig
config BR2_PACKAGE_PYTHON_GEVENT
	bool "python-gevent"
	select BR2_PACKAGE_PYTHON_CFFI # runtime
	select BR2_PACKAGE_PYTHON_GREENLET # runtime
	select BR2_PACKAGE_PYTHON_SETUPTOOLS # runtime
	select BR2_PACKAGE_PYTHON_ZOPEEVENT # runtime
	select BR2_PACKAGE_PYTHON_ZOPEINTERFACE # runtime
	select BR2_PACKAGE_LIBEV
	help
	  Coroutine-based network library.

	  http://www.gevent.org/
```

## buildroot/package/python-gmusicapi/Config.in
```kconfig
config BR2_PACKAGE_PYTHON_GMUSICAPI
	bool "python-gmusicapi"
	select BR2_PACKAGE_PYTHON_APPDIRS # runtime
	select BR2_PACKAGE_PYTHON_DATEUTIL # runtime
	select BR2_PACKAGE_PYTHON_DECORATOR # runtime
	select BR2_PACKAGE_PYTHON_FUTURE # runtime
	select BR2_PACKAGE_PYTHON_GPSOAUTH # runtime
	select BR2_PACKAGE_PYTHON_MECHANICALSOUP # runtime
	select BR2_PACKAGE_PYTHON_MOCK # runtime
	select BR2_PACKAGE_PYTHON_MUTAGEN # runtime
	select BR2_PACKAGE_PYTHON_OAUTH2CLIENT # runtime
	select BR2_PACKAGE_PYTHON_PROTOBUF # runtime
	select BR2_PACKAGE_PYTHON_REQUESTS # runtime
	select BR2_PACKAGE_PYTHON_SIX # runtime
	select BR2_PACKAGE_PYTHON_VALIDICTORY # runtime
	help
	  An unofficial api for Google Play Music.

	  http://pypi.python.org/pypi/gmusicapi/
```

## buildroot/package/python-gpiod/Config.in
```kconfig
config BR2_PACKAGE_PYTHON_GPIOD
	bool "python-gpiod"
	help
	  Python bindings for libgpiod.

	  https://git.kernel.org/pub/scm/libs/libgpiod/libgpiod.git
```

## buildroot/package/python-gpsoauth/Config.in
```kconfig
config BR2_PACKAGE_PYTHON_GPSOAUTH
	bool "python-gpsoauth"
	select BR2_PACKAGE_PYTHON_PYCRYPTODOMEX # runtime
	select BR2_PACKAGE_PYTHON_REQUESTS # runtime
	help
	  A python client library for Google Play Services OAuth.

	  https://github.com/simon-weber/gpsoauth
```

## buildroot/package/python-gstreamer-player/Config.in
```kconfig
config BR2_PACKAGE_PYTHON_GSTREAMER_PLAYER
	bool "python-gstreamer-player"
	select BR2_PACKAGE_PYTHON_MUTAGEN # runtime
	help
	  Python 3 wrapper for playing media via gstreamer.

	  https://github.com/happyleavesaoc/gstreamer-player/
```

## buildroot/package/python-hidapi/Config.in
```kconfig
config BR2_PACKAGE_PYTHON_HIDAPI
	bool "python-hidapi"
	select BR2_PACKAGE_PYTHON_SETUPTOOLS # runtime
	help
	  A Cython interface to the hidapi from
	  https://github.com/libusb/hidapi.

	  https://github.com/trezor/cython-hidapi
```

## buildroot/package/python-keyboard/Config.in
```kconfig
config BR2_PACKAGE_PYTHON_KEYBOARD
	bool "python-keyboard"
        help
	    Python keyboard module
        depends on BR2_PACKAGE_PYTHON3
```

## buildroot/package/python-levenshtein/Config.in
```kconfig
config BR2_PACKAGE_PYTHON_LEVENSHTEIN
	bool "python-levenshtein"
	select BR2_PACKAGE_PYTHON_SETUPTOOLS # runtime
	help
	  Python extension for computing string edit distances and
	  similarities.

	  http://github.com/ztane/python-Levenshtein
```

## buildroot/package/python-mechanicalsoup/Config.in
```kconfig
config BR2_PACKAGE_PYTHON_MECHANICALSOUP
	bool "python-mechanicalsoup"
	select BR2_PACKAGE_PYTHON_BEAUTIFULSOUP4 # runtime
	select BR2_PACKAGE_PYTHON_LXML # runtime
	select BR2_PACKAGE_PYTHON_REQUESTS # runtime
	select BR2_PACKAGE_PYTHON_SIX # runtime
	help
	  A Python library for automating interaction with websites.

	  https://mechanicalsoup.readthedocs.io/
```

## buildroot/package/python-musicbrainz-ngs/Config.in
```kconfig
config BR2_PACKAGE_PYTHON_MUSICBRAINZ_NGS
	bool "python-musicbrainz-ngs"
	help
	  A Python interface to the Musicbrainz database

	  https://github.com/alastair/python-musicbrainzngs
```

## buildroot/package/python-oauth2client/Config.in
```kconfig
config BR2_PACKAGE_PYTHON_OAUTH2CLIENT
	bool "python-oauth2client"
	select BR2_PACKAGE_PYTHON_HTTPLIB2 # runtime
	select BR2_PACKAGE_PYTHON_PYASN1 # runtime
	select BR2_PACKAGE_PYTHON_PYASN1_MODULES # runtime
	select BR2_PACKAGE_PYTHON_RSA # runtime
	select BR2_PACKAGE_PYTHON_SIX # runtime
	help
	  OAuth 2.0 client library.

	  http://github.com/google/oauth2client/
```

## buildroot/package/python-pg8000/Config.in
```kconfig
config BR2_PACKAGE_PYTHON_PG8000
	bool "python-pg8000"
	select BR2_PACKAGE_PYTHON_SCRAMP # runtime
	help
	  PostgreSQL interface library.

	  https://github.com/tlocke/pg8000
```

## buildroot/package/python-proboscis/Config.in
```kconfig
config BR2_PACKAGE_PYTHON_PROBOSCIS
	bool "python-proboscis"
	help
	  Extends Nose with certain TestNG like features.

	  https://github.com/rackspace/python-proboscis
```

## buildroot/package/python-pydbus/Config.in
```kconfig
config BR2_PACKAGE_PYTHON_PYDBUS
	bool "python-pydbus"
	help
	  Pythonic DBus library.

	  https://github.com/LEW21/pydbus
```

## buildroot/package/python-pyedbglib/Config.in
```kconfig
config BR2_PACKAGE_PYTHON_PYEDBGLIB
	bool "python-pyedbglib"
	help
	  A low-level protocol library for communicating with Microchip CMSIS-DAP based debuggers

	  https://github.com/microchip-pic-avr-tools/pyedbglib
```

## buildroot/package/python-pygobject/Config.in
```kconfig
config BR2_PACKAGE_PYTHON_PYGOBJECT
	bool "python-pygobject"
	select BR2_PACKAGE_PYTHON_PYCAIRO # runtime
	select BR2_PACKAGE_GOBJECT_INTROSPECTION
	help
	  Python bindings for GObject Introspection.

	  https://pygobject.readthedocs.io
```

## buildroot/package/python-pykka/Config.in
```kconfig
config BR2_PACKAGE_PYTHON_PYKKA
	bool "python-pykka"
	help
	  Pykka is a Python implementation of the actor model.

	  https://www.pykka.org/
```

## buildroot/package/python-pyky040/Config.in
```kconfig
config BR2_PACKAGE_PYTHON_PYKY040
	bool "python-pyky040"
	select BR2_PACKAGE_PYTHON_RPIGPIO # runtime
	help
	  High-level interface for the KY040 rotary encoder and
	  switch.

	  https://github.com/raphaelyancey/pyKY040
```
