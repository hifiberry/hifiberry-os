## buildroot/package/hifiberry-systemd/Config.in
```kconfig
config BR2_PACKAGE_HIFIBERRY_SYSTEMD
	bool "systemd optimisations"
        help
          optimize some default systemd configurations
	depends on BR2_PACKAGE_SYSTEMD
```

## buildroot/package/hifiberry-test/Config.in
```kconfig
config BR2_PACKAGE_HIFIBERRY_TEST
	bool "hifiberry-test"
	help
	  Tools to test the hardware of HiFiBerry boards
        select BR2_PACKAGE_HIFIBERRY_BASE
        select BR2_PACKAGE_DSPTOOLKIT
        select BR2_PACKAGE_SOX
	select BR2_PACKAGE_PYTHON_PYUPDI
	select BR2_PACKAGE_COPY_OVERLAYS
	select BR2_PACKAGE_CONFIGTXT
	select BR2_PACKAGE_OPENSSH
	select BR2_PACKAGE_OPENSSH_CLIENT
	select BR2_PACKAGE_OPENSSH_SERVER
	select BR2_PACKAGE_OPENSSH_KEY_UTILS
	select BR2_PACKAGE_OPENSSH_SANDBOX
	select BR2_PACKAGE_HATTOOLS

choice
    prompt "Card to test"
    config HIFIBERRY_TEST_NONE
          bool "None - just copy flash tools"
    config HIFIBERRY_TEST_AMP2
          bool "Amp2"
    config HIFIBERRY_TEST_AMP100
          bool "Amp 100"
    config HIFIBERRY_TEST_AMP4
          bool "Amp4"
    config HIFIBERRY_TEST_AMP4PRO
          bool "Amp4Pro"
    config HIFIBERRY_TEST_DAC2HD
          bool "DAC2 HD"
    config HIFIBERRY_TEST_DAC2PRO
          bool "DAC2 Pro"
    config HIFIBERRY_TEST_DAC2PROXLR
          bool "DAC2 Pro XLR"
    config HIFIBERRY_TEST_DAC8X
          bool "DAC8x" 
    config HIFIBERRY_TEST_DSPADDON
          bool "DSP add-on board"
    config HIFIBERRY_TEST_DACRTC
          bool "DAC+ RTC"
    config HIFIBERRY_TEST_DSPDAC
          bool "DAC+ DSP"
    config HIFIBERRY_TEST_BEOCREATE
           bool "Beocreate 4 channel amplifier"
    config HIFIBERRY_TEST_KADDSP
           bool "KAD DSP"
    config HIFIBERRY_TEST_DACADC
           bool "DAC+ ADC"
    config HIFIBERRY_TEST_DACADCPRO
           bool "DAC+ ADC Pro"
    config HIFIBERRY_TEST_DACADCPROXLR
           bool "DAC+ ADC Stage + XLR I/O"
    config HIFIBERRY_TEST_DIGI2PRO
           bool "Digi2 Pro"
    config HIFIBERRY_TEST_DIGI2STANDARD
           bool "Digi2 Standard"
    config HIFIBERRY_TEST_POWERCONTROLLER
           bool "Power controller"
endchoice
```

## buildroot/package/hifiberry-tools/Config.in
```kconfig
config BR2_PACKAGE_HIFIBERRY_TOOLS
	bool "hifiberry-tools"
        help
	  Several helper HiFiBerry helper tools
        depends on BR2_PACKAGE_HIFIBERRY_BASE
	select BR2_PACKAGE_COREUTILS
        select BR2_PACKAGE_PYTHON3
        select BR2_PACKAGE_PYTHON_SPIDEV
        select BR2_SYSTEM_BIN_SH_BASH
        select BR2_PACKAGE_LINUX_TOOLS_PERF
	select BR2_PACKAGE_LINUX_TOOLS_PERF_TUI
	select BR2_PACKAGE_JQ
	select BR2_PACKAGE_RNG_TOOLS
	select BR2_PACKAGE_ZIP
	select BR2_PACKAGE_PROCPS_NG
	select BR2_PACKAGE_PYTHON_USAGEDATA
	select BR2_PACKAGE_NANO
	select BR2_PACKAGE_RSYNC
	select BR2_PACKAGE_TAR
        select BR2_PACKAGE_BLUEZ5_UTILS
        select BR2_PACKAGE_BLUEZ5_UTILS_MONITOR
        select BR2_PACKAGE_BLUEZ5_UTILS_PLUGINS_HID
        select BR2_PACKAGE_BLUEZ5_UTILS_PLUGINS_HO
```

## buildroot/package/hifiberry-updater/Config.in
```kconfig
config BR2_PACKAGE_HIFIBERRY_UPDATER
	bool "hifiberry-updater"
        help
	  "Update tools for HiFiBerryOS"
	depends on BR2_PACKAGE_RPI_FIRMWARE
	select BR2_PACKAGE_E2FSPROGS
	select BR2_PACKAGE_E2FSPROGS_RESIZE2FS
	select BR2_PACKAGE_LIBCURL
	select BR2_PACKAGE_LIBCURL_CURL
	select BR2_PACKAGE_PARTED
        select BR2_PACKAGE_F2FS_TOOLS
```

## buildroot/package/hifiberry-upmpdcli/Config.in
```kconfig
config BR2_PACKAGE_HIFIBERRY_UPMPDCLI
	bool "hifiberry-upmpdcli"
	help
	  UPnP (DLNA) media renderer based on mpd
	select BR2_PACKAGE_LIBOPENSSL_BIN
	select BR2_PACKAGE_UPMPDCLI
```

## buildroot/package/hifiberry-users/Config.in
```kconfig
config BR2_PACKAGE_HIFIBERRY_USERS
	bool "hifiberry-users"
        help
	  Creates the users required by some other packages
        depends on BR2_PACKAGE_HIFIBERRY_BASE
```

## buildroot/package/hifiberry-watchdog/Config.in
```kconfig
config BR2_PACKAGE_HIFIBERRY_WATCHDOG
	bool "hifiberry-watchdog"
        help
	   Simple watchdog daemon that will reset the system when it hangs
```

## buildroot/package/hifiberry-weston/Config.in
```kconfig
config BR2_PACKAGE_HIFIBERRY_WESTON
	bool "hifiberry-weston"
        help
	  "local web browser"
        select BR2_PACKAGE_WAYLAND
	select BR2_PACKAGE_ENABLE_VC4KMS
	select BR2_PACKAGE_GLMARK2_EGL_GLES
	select BR2_PACKAGE_MESA3D
	select BR2_PACKAGE_MESA3D_GALLIUM_KMSRO
	select BR2_PACKAGE_MESA3D_GALLIUM_DRIVER
	select BR2_PACKAGE_MESA3D_GALLIUM_DRIVER_KMSRO
	select BR2_PACKAGE_MESA3D_GALLIUM_DRIVER_SWRAST
	select BR2_PACKAGE_MESA3D_GALLIUM_DRIVER_V3D
	select BR2_PACKAGE_MESA3D_GALLIUM_DRIVER_VC4
	select BR2_PACKAGE_MESA3D_DRIVER
	select BR2_PACKAGE_MESA3D_NEEDS_XA
	select BR2_PACKAGE_MESA3D_GALLIUM_KMSRO
	select BR2_PACKAGE_MESA3D_OPENGL_EGL
	select BR2_PACKAGE_MESA3D_OPENGL_ES
	select BR2_PACKAGE_MESA3D_GBM
	select BR2_PACKAGE_WESTON
	select BR2_PACKAGE_WESTON_HAS_COMPOSITOR
	select BR2_PACKAGE_WESTON_DRM
	select BR2_PACKAGE_XKEYBOARD_CONFIG
	select BR2_PACKAGE_LIBDRM
	select BR2_PACKAGE_LIBDRM_HAS_ATOMIC
	select BR2_PACKAGE_LIBDRM_VC4
	select BR2_PACKAGE_HAS_LIBEGL
	select BR2_PACKAGE_HAS_LIBEGL_WAYLAND
	select BR2_PACKAGE_HAS_LIBGLES
	select BR2_PACKAGE_WAFFLE_SUPPORTS_WAYLAND
	select BR2_PACKAGE_WAFFLE_SUPPORTS_GBM
   
```

## buildroot/package/hifiberry-ympd/Config.in
```kconfig
config BR2_PACKAGE_HIFIBERRY_YMPD
	bool "hifiberry-ympd"
        help
	  "ympd MPD web interface"
        select BR2_PACKAGE_YMPD
```

## buildroot/package/initial-config/Config.in
```kconfig
config BR2_PACKAGE_INITIAL_CONFIG
	bool "initial-config"
        help
	  Allows to start a script from the FAT partition during statup
```
