## buildroot/package/hifiberry-analytics/Config.in
```kconfig
config BR2_PACKAGE_HIFIBERRY_ANALYTICS
	bool "hifiberry-analytics"
        help
	  Some analytics tools
        depends on BR2_PACKAGE_HIFIBERRY_POSTGRES
```

## buildroot/package/hifiberry-automount/Config.in
```kconfig
config BR2_PACKAGE_HIFIBERRY_AUTOMOUNT
	bool "hifiberry-automount"
        help
	  Automatically mount USB devices
```

## buildroot/package/hifiberry-base/Config.in
```kconfig
config BR2_PACKAGE_HIFIBERRY_BASE
	bool "hifiberry-base"
        help
          install some base HiFiBerryOS prerequisites
        depends on BR2_INIT_SYSTEMD
        select BR2_PACKAGE_ALSA_UTILS
	select BR2_PACKAGE_ALSA_UTILS_ALSACTL
	select BR2_PACKAGE_ALSA_UTILS_ALSAMIXER
	select BR2_PACKAGE_ALSA_UTILS_AMIXER
	select BR2_PACKAGE_ALSA_UTILS_APLAY
        select BR2_PACKAGE_NTP
	select BR2_PACKAGE_NTP_NTPD
	select BR2_PACKAGE_NTP_NTPDATE
	select BR2_PACKAGE_NTP_NTPTIME
	select BR2_PACKAGE_BASH
	select BR2_PACKAGE_SOX
	select BR2_PACKAGE_LINUX_TOOLS_GPIO
	select BR2_PACKAGE_UTIL_LINUX_KILL
```

## buildroot/package/hifiberry-bluezalsa/Config.in
```kconfig
config BR2_PACKAGE_HIFIBERRY_BLUEZALSA
	bool "hifiberry-bluezalsa"
	depends on !BR2_STATIC_LIBS # bluez5
	depends on !BR2_PACKAGE_BLUEZ_UTILS # bluez5
        depends on !BR2_PACKAGE_BLUEZ_ALSA
	depends on BR2_TOOLCHAIN_HAS_THREADS_NPTL
	depends on BR2_TOOLCHAIN_HEADERS_AT_LEAST_3_4 # bluez5
	depends on BR2_TOOLCHAIN_HAS_SYNC_4 # bluez5
	depends on BR2_USE_MMU # bluez5 -> dbus
	depends on BR2_USE_WCHAR # libglib2
	select BR2_PACKAGE_ALSA_LIB
	select BR2_PACKAGE_BLUEZ5_UTILS
	select BR2_PACKAGE_LIBGLIB2
	select BR2_PACKAGE_SBC
        select BR2_PACKAGE_FDK_AAC
	select BR2_PACKAGE_BLUEZ_TOOLS
	select BR2_PACKAGE_BLUEZ5_UTILS_CLIENT
	select BR2_PACKAGE_BLUEZ5_UTILS_TOOLS
	select BR2_PACKAGE_BLUEZ5_UTILS_DEPRECATED
	select BR2_PACKAGE_BLUEZ5_UTILS_PLUGINS_AUDIO
	select BR2_PACKAGE_BLUEZ5_UTILS_PLUGINS_NETWORK
	help
	  Bluetooth Audio ALSA Backend.

	  https://github.com/Arkq/bluez-alsa

comment "bluez-alsa needs a toolchain w/ wchar, NPTL, headers >= 3.4, dynamic library"
	depends on !BR2_USE_WCHAR || !BR2_TOOLCHAIN_HAS_THREADS_NPTL || \
		!BR2_TOOLCHAIN_HEADERS_AT_LEAST_3_4 || BR2_STATIC_LIBS
	depends on BR2_TOOLCHAIN_HAS_SYNC_4
	depends on BR2_USE_MMU
	depends on !BR2_PACKAGE_BLUEZ_UTILS

comment "HiFiBerry bluezalsa package can't be used together with buildroot bluezalsa version, disable this first!"
        depends on BR2_PACKAGE_BLUEZ_ALSA
```

## buildroot/package/hifiberry-docker/Config.in
```kconfig
config BR2_PACKAGE_HIFIBERRY_DOCKER
	bool "docker environment"
        help
          add docker, configuration and tools
	select BR2_PACKAGE_PYTHON_DOCKER
	select BR2_PACKAGE_PYTHON_DOCKERPTY
	select BR2_PACKAGE_DOCKER_CLI
	select BR2_PACKAGE_DOCKER_COMPOSE
	select BR2_PACKAGE_CONTAINERD
	select BR2_PACKAGE_DOCKER_ENGINE
	select BR2_PACKAGE_DOCKER_PROXY
```

## buildroot/package/hifiberry-gmrender/Config.in
```kconfig
config BR2_PACKAGE_HIFIBERRY_GMRENDER
	bool "hifiberry-gmrender"
	depends on BR2_USE_WCHAR # gstreamer1 -> libglib2
	depends on BR2_TOOLCHAIN_HAS_THREADS # gstreamer1 -> libglib2, libupnp
	depends on BR2_USE_MMU # gstreamer1
	select BR2_PACKAGE_LIBUPNP
 	select BR2_PACKAGE_LIBSHOUT
        select BR2_PACKAGE_HIFIBERRY_GSTREAMER
        select BR2_PACKAGE_GSTREAMER1
        select BR2_PACKAGE_GSTREAMER1_CHECK
        select BR2_PACKAGE_GSTREAMER1_PARSE
        select BR2_PACKAGE_GSTREAMER1_PLUGIN_REGISTRY
        select BR2_PACKAGE_GSTREAMER1_INSTALL_TOOLS
#        select BR2_PACKAGE_GSTREAMER1_MM
        select BR2_PACKAGE_GST1_PLUGINS_BASE
        select BR2_PACKAGE_GST1_PLUGINS_BASE_INSTALL_TOOLS
        select BR2_PACKAGE_GST1_PLUGINS_BASE_PLUGIN_ADDER
        select BR2_PACKAGE_GST1_PLUGINS_BASE_PLUGIN_APP
        select BR2_PACKAGE_GST1_PLUGINS_BASE_PLUGIN_AUDIOCONVERT
        select BR2_PACKAGE_GST1_PLUGINS_BASE_PLUGIN_AUDIOMIXER
        select BR2_PACKAGE_GST1_PLUGINS_BASE_PLUGIN_AUDIORATE
        select BR2_PACKAGE_GST1_PLUGINS_BASE_PLUGIN_AUDIOTESTSRC
        select BR2_PACKAGE_GST1_PLUGINS_BASE_PLUGIN_COMPOSITOR
        select BR2_PACKAGE_GST1_PLUGINS_BASE_PLUGIN_ENCODING
        select BR2_PACKAGE_GST1_PLUGINS_BASE_PLUGIN_GIO
        select BR2_PACKAGE_GST1_PLUGINS_BASE_PLUGIN_PLAYBACK
        select BR2_PACKAGE_GST1_PLUGINS_BASE_PLUGIN_AUDIORESAMPLE
        select BR2_PACKAGE_GST1_PLUGINS_BASE_PLUGIN_RAWPARSE
        select BR2_PACKAGE_GST1_PLUGINS_BASE_PLUGIN_SUBPARSE
        select BR2_PACKAGE_GST1_PLUGINS_BASE_PLUGIN_TCP
        select BR2_PACKAGE_GST1_PLUGINS_BASE_PLUGIN_TYPEFIND
        select BR2_PACKAGE_GST1_PLUGINS_BASE_PLUGIN_VOLUME
        select BR2_PACKAGE_GST1_PLUGINS_BASE_PLUGIN_ALSA
        select BR2_PACKAGE_GST1_PLUGINS_BASE_PLUGIN_TREMOR
        select BR2_PACKAGE_GST1_PLUGINS_BASE_PLUGIN_OGG
        select BR2_PACKAGE_GST1_PLUGINS_BASE_PLUGIN_OPUS
        select BR2_PACKAGE_GST1_PLUGINS_BASE_PLUGIN_PANGO
        select BR2_PACKAGE_GST1_PLUGINS_BASE_PLUGIN_THEORA
        select BR2_PACKAGE_GST1_PLUGINS_BASE_PLUGIN_VORBIS
        select BR2_PACKAGE_GST1_PLUGINS_GOOD
        select BR2_PACKAGE_GST1_PLUGINS_GOOD_JPEG
        select BR2_PACKAGE_GST1_PLUGINS_GOOD_PNG
        select BR2_PACKAGE_GST1_PLUGINS_GOOD_BZ2
        select BR2_PACKAGE_GST1_PLUGINS_GOOD_PLUGIN_ALPHA
        select BR2_PACKAGE_GST1_PLUGINS_GOOD_PLUGIN_APETAG
        select BR2_PACKAGE_GST1_PLUGINS_GOOD_PLUGIN_AUDIOFX
        select BR2_PACKAGE_GST1_PLUGINS_GOOD_PLUGIN_AUDIOPARSERS
        select BR2_PACKAGE_GST1_PLUGINS_GOOD_PLUGIN_AUPARSE
        select BR2_PACKAGE_GST1_PLUGINS_GOOD_PLUGIN_AUTODETECT
        select BR2_PACKAGE_GST1_PLUGINS_GOOD_PLUGIN_CUTTER
        select BR2_PACKAGE_GST1_PLUGINS_GOOD_PLUGIN_DEBUGUTILS
        select BR2_PACKAGE_GST1_PLUGINS_GOOD_PLUGIN_DTMF
        select BR2_PACKAGE_GST1_PLUGINS_GOOD_PLUGIN_EFFECTV
        select BR2_PACKAGE_GST1_PLUGINS_GOOD_PLUGIN_FLX
        select BR2_PACKAGE_GST1_PLUGINS_GOOD_PLUGIN_GOOM
        select BR2_PACKAGE_GST1_PLUGINS_GOOD_PLUGIN_GOOM2K1
        select BR2_PACKAGE_GST1_PLUGINS_GOOD_PLUGIN_ICYDEMUX
        select BR2_PACKAGE_GST1_PLUGINS_GOOD_PLUGIN_ID3DEMUX
        select BR2_PACKAGE_GST1_PLUGINS_GOOD_PLUGIN_INTERLEAVE
        select BR2_PACKAGE_GST1_PLUGINS_GOOD_PLUGIN_ISOMP4
        select BR2_PACKAGE_GST1_PLUGINS_GOOD_PLUGIN_LAW
        select BR2_PACKAGE_GST1_PLUGINS_GOOD_PLUGIN_LEVEL
        select BR2_PACKAGE_GST1_PLUGINS_GOOD_PLUGIN_MONOSCOPE
        select BR2_PACKAGE_GST1_PLUGINS_GOOD_PLUGIN_MULTIFILE
        select BR2_PACKAGE_GST1_PLUGINS_GOOD_PLUGIN_MULTIPART
        select BR2_PACKAGE_GST1_PLUGINS_GOOD_PLUGIN_REPLAYGAIN
        select BR2_PACKAGE_GST1_PLUGINS_GOOD_PLUGIN_RTP
        select BR2_PACKAGE_GST1_PLUGINS_GOOD_PLUGIN_RTPMANAGER
        select BR2_PACKAGE_GST1_PLUGINS_GOOD_PLUGIN_RTSP
        select BR2_PACKAGE_GST1_PLUGINS_GOOD_PLUGIN_SHAPEWIPE
        select BR2_PACKAGE_GST1_PLUGINS_GOOD_PLUGIN_SMPTE
        select BR2_PACKAGE_GST1_PLUGINS_GOOD_PLUGIN_UDP
        select BR2_PACKAGE_GST1_PLUGINS_GOOD_PLUGIN_WAVENC
        select BR2_PACKAGE_GST1_PLUGINS_GOOD_PLUGIN_WAVPARSE
        select BR2_PACKAGE_GST1_PLUGINS_GOOD_PLUGIN_Y4M
        select BR2_PACKAGE_GST1_PLUGINS_GOOD_PLUGIN_LAME
        select BR2_PACKAGE_GST1_PLUGINS_GOOD_PLUGIN_MPG123
        select BR2_PACKAGE_GST1_PLUGINS_GOOD_PLUGIN_FLAC
        select BR2_PACKAGE_GST1_PLUGINS_GOOD_PLUGIN_SOUPHTTPSRC
        select BR2_PACKAGE_GST1_PLUGINS_GOOD_PLUGIN_SPEEX
        select BR2_PACKAGE_GST1_PLUGINS_GOOD_PLUGIN_TWOLAME
        select BR2_PACKAGE_GST1_PLUGINS_GOOD_PLUGIN_WAVPACK
        select BR2_PACKAGE_GST1_LIBAV
	help
	  UPnP (DLNA) media renderer based on gstreamer

	  https://github.com/hzeller/gmrender-resurrect

comment "gmrender-resurrect needs a toolchain w/ wchar, threads"
	depends on BR2_USE_MMU
	depends on !BR2_USE_WCHAR || !BR2_TOOLCHAIN_HAS_THREADS
```

## buildroot/package/hifiberry-gstreamer/Config.in
```kconfig
config BR2_PACKAGE_HIFIBERRY_GSTREAMER
        bool "hifiberry-gstreamer"
        help
          Helper package to select GStreamer and the necessary modules
	select BR2_PACKAGE_GSTREAMER1
        select BR2_PACKAGE_GSTREAMER1_CHECK
        select BR2_PACKAGE_GSTREAMER1_PLUGIN_REGISTRY
        select BR2_PACKAGE_GSTREAMER1_INSTALL_TOOLS
	select BR2_PACKAGE_GSTREAMER1_MM
        select BR2_PACKAGE_GST1_PLUGINS_BASE
	select BR2_PACKAGE_GST1_PLUGINS_BASE_INSTALL_TOOLS
        select BR2_PACKAGE_GST1_PLUGINS_BASE_PLUGIN_ADDER
        select BR2_PACKAGE_GST1_PLUGINS_BASE_PLUGIN_APP
        select BR2_PACKAGE_GST1_PLUGINS_BASE_PLUGIN_AUDIOCONVERT
        select BR2_PACKAGE_GST1_PLUGINS_BASE_PLUGIN_AUDIOMIXER
        select BR2_PACKAGE_GST1_PLUGINS_BASE_PLUGIN_AUDIORATE
        select BR2_PACKAGE_GST1_PLUGINS_BASE_PLUGIN_AUDIOTESTSRC
        select BR2_PACKAGE_GST1_PLUGINS_BASE_PLUGIN_ENCODING
        select BR2_PACKAGE_GST1_PLUGINS_BASE_PLUGIN_PLAYBACK
        select BR2_PACKAGE_GST1_PLUGINS_BASE_PLUGIN_AUDIORESAMPLE
        select BR2_PACKAGE_GST1_PLUGINS_BASE_PLUGIN_TYPEFIND
        select BR2_PACKAGE_GST1_PLUGINS_BASE_PLUGIN_VOLUME
        select BR2_PACKAGE_GST1_PLUGINS_BASE_PLUGIN_ALSA
        select BR2_PACKAGE_GST1_PLUGINS_BASE_PLUGIN_TREMOR
        select BR2_PACKAGE_GST1_PLUGINS_BASE_PLUGIN_OGG
        select BR2_PACKAGE_GST1_PLUGINS_BASE_PLUGIN_VORBIS
        select BR2_PACKAGE_GST1_PLUGINS_GOOD
        select BR2_PACKAGE_GST1_PLUGINS_GOOD_PLUGIN_AUDIOFX
        select BR2_PACKAGE_GST1_PLUGINS_GOOD_PLUGIN_AUDIOPARSERS
        select BR2_PACKAGE_GST1_PLUGINS_GOOD_PLUGIN_AUTODETECT
        select BR2_PACKAGE_GST1_PLUGINS_GOOD_PLUGIN_ID3DEMUX
        select BR2_PACKAGE_GST1_PLUGINS_GOOD_PLUGIN_MATROSKA
        select BR2_PACKAGE_GST1_PLUGINS_GOOD_PLUGIN_RTP
        select BR2_PACKAGE_GST1_PLUGINS_GOOD_PLUGIN_WAVPARSE
        select BR2_PACKAGE_GST1_PLUGINS_GOOD_PLUGIN_LAME
        select BR2_PACKAGE_GST1_PLUGINS_GOOD_PLUGIN_FLAC
        select BR2_PACKAGE_GST1_PLUGINS_BAD
        select BR2_PACKAGE_GST1_PLUGINS_BAD_PLUGIN_ID3TAG
        select BR2_PACKAGE_GST1_PLUGINS_BAD_PLUGIN_CURL
        select BR2_PACKAGE_GST1_PLUGINS_BAD_PLUGIN_FAAD
        select BR2_PACKAGE_GST1_PLUGINS_UGLY
        select BR2_PACKAGE_PYTHON_GSTREAMER_PLAYER
```

## buildroot/package/hifiberry-localbrowser/Config.in
```kconfig
config BR2_PACKAGE_HIFIBERRY_LOCALBROWSER
	bool "hifiberry-localbrowser"
        help
	  "local web browser"
	select BR2_PACKAGE_DEJAVU
        select BR2_PACKAGE_HIFIBERRY_WESTON
	select BR2_PACKAGE_DEJAVU_MONO
	select BR2_PACKAGE_DEJAVU_SANS
	select BR2_PACKAGE_DEJAVU_SERIF
	select BR2_PACKAGE_DEJAVU_SANS_CONDENSED
	select BR2_PACKAGE_DEJAVU_SERIF_CONDENSED
	select BR2_PACKAGE_COG
        select BR2_PACKAGE_LIBWPE
	select BR2_PACKAGE_GLIB_NETWORKING
	select BR2_PACKAGE_WPEBACKEND_FDO
	select BR2_PACKAGE_WPEWEBKIT_ARCH_SUPPORTS
	select BR2_PACKAGE_WPEWEBKIT
        select BR2_PACKAGE_HARFBUZZ
	select BR2_PACKAGE_LIBEPOXY
	select BR2_PACKAGE_WEBP
	select BR2_PACKAGE_GLMARK2_EGL_GLES
	select BR2_PACKAGE_WAFFLE_SUPPORTS_WAYLAND
	select BR2_PACKAGE_WAFFLE_SUPPORTS_GBM
	select BR2_PACKAGE_WEBP_DEMUX
	select BR2_PACKAGE_NANUMFONT
   
```

## buildroot/package/hifiberry-measurements/Config.in
```kconfig
config BR2_PACKAGE_HIFIBERRY_MEASUREMENTS
	bool "hifiberry-measurements"
        help
	  Tools for acoustic measurements
```

## buildroot/package/hifiberry-mpd-cd-autoplay/Config.in
```kconfig
config BR2_PACKAGE_HIFIBERRY_MPD_CD_AUTOPLAY
	bool "hifiberry-mpd-cd-autoplay"
        help
	  Automatically play CDs with mpd when you insert them
        depends on BR2_PACKAGE_HIFIBERRY_BASE
				select BR2_PACKAGE_HIFIBERRY_MPD
				select BR2_PACKAGE_PYTHON_DISCID
```

## buildroot/package/hifiberry-mpd/Config.in
```kconfig
config BR2_PACKAGE_HIFIBERRY_MPD
	bool "hifiberry-mpd"
        help
	  Start script and configuration files for MPD
        depends on BR2_PACKAGE_HIFIBERRY_BASE
#        depends on !BR2_PACKAGE_MPD
	select BR2_PACKAGE_LIBCURL
	select BR2_PACKAGE_FAAD2
	select BR2_PACKAGE_LAME 
	select BR2_PACKAGE_LIBSHOUT
	select BR2_PACKAGE_EXPAT
        select BR2_PACKAGE_LIBUPNP
	select BR2_PACKAGE_OPUS
        select BR2_PACKAGE_LIBOGG
	select BR2_PACKAGE_SAMBA4
	select BR2_PACKAGE_YAJL
	select BR2_PACKAGE_AVAH
	select BR2_PACKAGE_BOOS
	select BR2_PACKAGE_FFMPEG
	select BR2_PACKAGE_FLAC
	select BR2_PACKAGE_ICU	
	select BR2_PACKAGE_LIBGCRYPT
	select BR2_PACKAGE_LIBID3TAG
	select BR2_PACKAGE_LIBMAD
	select BR2_PACKAGE_LIBSNDFILE
	select BR2_PACKAGE_SQLITE
	select BR2_PACKAGE_WAVPACK
	select BR2_PACKAGE_LIBNFS
	select BR2_PACKAGE_LIBMMS
	select BR2_PACKAGE_LIBSAMPLERATE
	select BR2_PACKAGE_LIBURING
	select BR2_PACKAGE_LIBFMT
	select BR2_PACKAGE_FMT
	select BR2_PACKAGE_IMAGEMAGICK
	select BR2_PACKAGE_PYTHON_PILLOW

comment "HiFiBerry mpd package can't be used together with buildroot mpd version, disable this first!"
        depends on BR2_PACKAGE_MPD
```

## buildroot/package/hifiberry-postgres/Config.in
```kconfig
config BR2_PACKAGE_HIFIBERRY_POSTGRES
	bool "hifiberry-postgres"
        help
	  Start script and configuration files for PostgreSQL
        select BR2_PACKAGE_POSTGRESQL
        select BR2_PACKAGE_PYTHON_PSYCOPG2
```

## buildroot/package/hifiberry-powercontroller/Config.in
```kconfig
config BR2_PACKAGE_HIFIBERRY_POWERCONTROLLER
	bool "hifiberry-powercontroller"
        help
	  Support for the HiFiBerry power controller
        depends on BR2_PACKAGE_HIFIBERRY_BASE
	select BR2_PACKAGE_I2C_TOOLS
```

## buildroot/package/hifiberry-shairport/Config.in
```kconfig
config BR2_PACKAGE_HIFIBERRY_SHAIRPORT
	bool "hifiberry-shairport"
        help
	  Start script and configuration files for Shairport
        depends on BR2_PACKAGE_HIFIBERRY_BASE
        depends on !BR2_PACKAGE_SHAIRPORT_SYNC
        depends on BR2_USE_MMU # libdaemon
        depends on BR2_TOOLCHAIN_HAS_THREADS_NPTL
        depends on BR2_INSTALL_LIBSTDCPP
        select BR2_PACKAGE_ALSA_LIB
        select BR2_PACKAGE_ALSA_LIB_MIXER
        select BR2_PACKAGE_LIBCONFIG
        select BR2_PACKAGE_LIBDAEMON
        select BR2_PACKAGE_OPENSSL if !BR2_PACKAGE_MBEDTLS
        select BR2_PACKAGE_POPT

config BR2_PACKAGE_HIFIBERRY_SHAIRPORT_LIBSOXR
        bool "libsoxr support"
	depends on BR2_PACKAGE_HIFIBERRY_SHAIRPORT
        select BR2_PACKAGE_LIBSOXR
        help
          Enable support for libsoxr, the SoX Resampler library.

          Briefly, Shairport Sync keeps in step with the audio source
          by deleting or inserting frames of audio into the stream as
          needed. This "interpolation" is normally inaudible, but it
          can be heard in some circumstances. Libsoxr allows this
          interpolation to be done much more smoothly and subtly.

config BR2_PACKAGE_HIFIBERRY_SHAIRPORT_AIRPLAY2
	bool "Airplay 2 support (very experimental)
	depends on BR2_PACKAGE_HIFIBERRY_SHAIRPORT
	select BR2_PACKAGE_LIBPLIST
	select BR2_PACKAGE_NQPTP
	help
	  Enable experimental support for Airplay 2

comment "shairport-sync needs a toolchain w/ C++, NPTL"
        depends on BR2_USE_MMU
        depends on !BR2_INSTALL_LIBSTDCPP || !BR2_TOOLCHAIN_HAS_THREADS_NPTL

comment "HiFiBerry shairport package can't be used together with buildroot shairport version, disable this first!"
        depends on BR2_PACKAGE_SHAIRPORT_SYNC
```

## buildroot/package/hifiberry-squeezelite/Config.in
```kconfig
config BR2_PACKAGE_HIFIBERRY_SQUEEZELITE
	bool "hifiberry-squeezelite"
        help
	  Squeezelite adapted for HiFiBerryOS
        depends on BR2_PACKAGE_HIFIBERRY_BASE
        depends on !BR2_PACKAGE_SQUEEZELITE
        select BR2_PACKAGE_ALSA_LIB
        select BR2_PACKAGE_ALSA_LIB_MIXER
        select BR2_PACKAGE_FAAD2
        select BR2_PACKAGE_LAME
	select BR2_PACKAGE_JQ

comment "HiFiBerry squeezelite package can't be used together with buildroot squeezelite version, disable this first!"
        depends on BR2_PACKAGE_SQUEEZELITE
```
