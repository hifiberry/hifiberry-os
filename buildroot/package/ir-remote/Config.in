## buildroot/package/ir-remote/Config.in
```kconfig
config BR2_PACKAGE_IR_REMOTE
	bool "IR Remote"
        help
	  "Control HiFiBerryOS using an IR remote control"
    depends on BR2_PACKAGE_CONFIGTXT
    depends on BR2_PACKAGE_COPY_OVERLAYS
    depends on BR2_PACKAGE_HIFIBERRY_UPDATER
    select BR2_PACKAGE_LIBV4L
    select BR2_PACKAGE_LIBV4L_UTILS
```

## buildroot/package/libdiscid/Config.in
```kconfig
config BR2_PACKAGE_LIBDISCID
	bool "libdiscid"
	help
	  A Library for creating MusicBrainz DiscIDs
	  https://github.com/metabrainz/libdiscid
```

## buildroot/package/librespot/Config.in
```kconfig
config BR2_PACKAGE_LIBRESPOT
	bool "librespot"
        help
	  An open source Spotify player
        select BR2_PACKAGE_HOST_CARGO
	select BR2_PACKAGE_HOST_RUSTC
```

## buildroot/package/lmsmpris/Config.in
```kconfig
config BR2_PACKAGE_LMSMPRIS
	bool "lmsmpris"
        help
	  "MPRIS interface for LMS"
        select BR2_PACKAGE_DBUS
	select BR2_PACKAGE_DBUS_PYTHON
        select BR2_PACKAGE_PYTHON_NETIFACES
```

## buildroot/package/mopidy-alsamixer/Config.in
```kconfig
config BR2_PACKAGE_MOPIDY_ALSAMIXER
	bool "mopidy-alsamixer"
	help
	  Mopidy - ALSA mixer support

	  https://mopidy.com/
	depends on BR2_PACKAGE_MOPIDY
```

## buildroot/package/mopidy-gmusic/Config.in
```kconfig
config BR2_PACKAGE_MOPIDY_GMUSIC
	bool "mopidy-gmusic"
	help
	  Mopidy - Google Play Music

	  https://mopidy.com/
	depends on BR2_PACKAGE_MOPIDY
	select BR2_PACKAGE_PYTHON_GMUSICAPI
	select BR2_PACKAGE_PYTHON_OAUTH2CLIEN
	select BR2_PACKAGE_PYTHON_VALIDICTOR
	select BR2_PACKAGE_PYTHON_GPSOAUTH
	select BR2_PACKAGE_PYTHON_MECHANICALSOUP
	select BR2_PACKAGE_PYTHON_APPDIR
	select BR2_PACKAGE_PYTHON_MOCK
```

## buildroot/package/mopidy-iris/Config.in
```kconfig
config BR2_PACKAGE_MOPIDY_IRIS
	bool "mopidy-iris"
	help
	  Mopidy - IRIS web interface

	  https://mopidy.com/
	depends on BR2_PACKAGE_MOPIDY
```

## buildroot/package/mopidy-local/Config.in
```kconfig
config BR2_PACKAGE_MOPIDY_LOCAL
	bool "mopidy-local"
	help
	  Mopidy - support for local library

	  https://mopidy.com/
	depends on BR2_PACKAGE_MOPIDY
	select BR2_PACKAGE_PYTHON3_SQLITE
```

## buildroot/package/mopidy-mpd/Config.in
```kconfig
config BR2_PACKAGE_MOPIDY_MPD
	bool "mopidy-mpd"
	help
	  Mopidy - MPD interface

	  https://mopidy.com/
	depends on BR2_PACKAGE_MOPIDY
```

## buildroot/package/mopidy-mpris/Config.in
```kconfig
config BR2_PACKAGE_MOPIDY_MPRIS
	bool "mopidy-mpris"
	help
	  Mopidy - MPRIS support

	  https://mopidy.com/
	depends on BR2_PACKAGE_MOPIDY
	select BR2_PACKAGE_PYTHON_PYDBUS
```

## buildroot/package/mopidy-musicbox-webclient/Config.in
```kconfig
config BR2_PACKAGE_MOPIDY_MUSICBOX_WEBCLIENT
	bool "mopidy-musicbox-webclient"
	help
	  Mopidy - Musicbox web client

	  https://mopidy.com/
	depends on BR2_PACKAGE_MOPIDY
```

## buildroot/package/mopidy-radionet/Config.in
```kconfig
config BR2_PACKAGE_MOPIDY_RADIONET
	bool "mopidy-radionet"
	help
	  Mopidy - Radionet

	  https://mopidy.com/
	depends on BR2_PACKAGE_MOPIDY
	select BR2_PACKAGE_PYTHON_URITOOLS
```

## buildroot/package/mopidy-soundcloud/Config.in
```kconfig
config BR2_PACKAGE_MOPIDY_SOUNDCLOUD
	bool "mopidy-soundcloud"
	help
	  Mopidy - Soundcloud

	  https://mopidy.com/
	depends on BR2_PACKAGE_MOPIDY
```

## buildroot/package/mopidy-spotify/Config.in
```kconfig
config BR2_PACKAGE_MOPIDY_SPOTIFY
	bool "mopidy-spotify"
	help
	  Mopidy - Spotify

	  https://mopidy.com/
	depends on BR2_PACKAGE_MOPIDY
```

## buildroot/package/mopidy-youtube/Config.in
```kconfig
config BR2_PACKAGE_MOPIDY_YOUTUBE
	bool "mopidy-youtube"
	help
	  Mopidy - Youtube

	  https://mopidy.com/
	depends on BR2_PACKAGE_MOPIDY
	select BR2_PACKAGE_PYTHON_YOUTUBE_DL
	select BR2_PACKAGE_PYTHON_URITOOL
	select BR2_PACKAGE_PYTHON_BEAUTIFULSOUP4
	select BR2_PACKAGE_PYTHON_CACHETOOLS
```

## buildroot/package/mopidy/Config.in
```kconfig
config BR2_PACKAGE_MOPIDY
	bool "mopidy"
	help
	  Mopidy music server

	  https://mopidy.com/
	select BR2_PACKAGE_USBMOUNT
	select BR2_PACKAGE_PYTHON_PYKKA
	select BR2_PACKAGE_PYTHON_URITOOLS
```

## buildroot/package/mpd-mpris/Config.in
```kconfig
config BR2_PACKAGE_MPD_MPRIS
	bool "mpd-mpris"
        help
	  MPRIS interface for mpd
        depends on BR2_PACKAGE_HIFIBERRY_BASE
	depends on BR2_PACKAGE_MPD
```

## buildroot/package/mpris-proxy/Config.in
```kconfig
config BR2_PACKAGE_MPRIS_PROXY
	bool "mpris-proxy"
        help
	  MPRIS control for Bluetooth
        depends on BR2_PACKAGE_HIFIBERRY_BASE
        select BR2_PACKAGE_HIFIBERRY_BLUEZALSA
```

## buildroot/package/musicfiletools/Config.in
```kconfig
config BR2_PACKAGE_MUSICFILETOOLS
	bool "musicfiletools"
        help
	  A collection of tools to work with music files
        depends on BR2_PACKAGE_PYTHON3
        select BR2_PACKAGE_PYTHON_MUTAGEN
```

## buildroot/package/nanumfont/Config.in
```kconfig
config BR2_PACKAGE_NANUMFONT
    bool "nanumfont"
    help
      NanumGothicCoding font package

      This package downloads the NanumGothicCoding font from GitHub
      and installs it
```

## buildroot/package/nqptp/Config.in
```kconfig
config BR2_PACKAGE_NQPTP
	bool "nqptp"
        help
	  NQPTP deamon (required for Airplay2)
```

## buildroot/package/pigpiod-systemd/Config.in
```kconfig
config BR2_PACKAGE_PIGPIOD_SYSTEMD
	bool "pigpiod-systemd"
        help
	  "GPIOd systemd integration"
	select BR2_PACKAGE_LIBGPIOD
	select BR2_PACKAGE_LIBGPIOD_TOOLS
```

## buildroot/package/piversion/Config.in
```kconfig
config BR2_PACKAGE_PIVERSION
	bool "Pi Version"
        help
	  "defines what Pi this is coimpiled for"


choice
    prompt "Pi version"
    config BR2_PACKAGE_PIVERSION_0w
          bool "Pi 0w"
    config BR2_PACKAGE_PIVERSION_2
          bool "Pi 2"
    config BR2_PACKAGE_PIVERSION_3
          bool "Pi 3"
    config BR2_PACKAGE_PIVERSION_4
          bool "Pi 4"
    config BR2_PACKAGE_PIVERSION_0_2
         bool "Pi Zero 2w"
endchoice
```

## buildroot/package/plexamp/Config.in
```kconfig
config BR2_PACKAGE_PLEXAMP
	bool "plexamp"
	help
	  PlexAmp is a headless audio player that acts as a player
	  for a Plex Media Server

	depends on BR2_PACKAGE_BEOCREATE
```

## buildroot/package/python-bottle-websocket/Config.in
```kconfig
config BR2_PACKAGE_PYTHON_BOTTLE_WEBSOCKET
	bool "python-bottle-websocket"
	select BR2_PACKAGE_PYTHON_BOTTLE # runtime
	select BR2_PACKAGE_PYTHON_GEVENT_WEBSOCKET # runtime
	help
	  WebSockets for bottle.

	  https://github.com/zeekay/bottle-websocket
```
