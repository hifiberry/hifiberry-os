## buildroot/package/webradio/Config.in
```kconfig
config BR2_PACKAGE_WEBRADIO
	bool "webradio"
        help
	  Tools fosten to web radio stations (incl. TuneIn)
        depends on BR2_PACKAGE_HIFIBERRY_BASE
```

## buildroot/package/wisa-scripts/Config.in
```kconfig
config BR2_PACKAGE_WISA_SCRIPTS
	bool "WISA scripts (startup etc.)"
        help
	  Installs the necessary WiSA control scripts
        depends on BR2_PACKAGE_PYTHON_WISA
```
