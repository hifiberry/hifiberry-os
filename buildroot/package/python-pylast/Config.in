## buildroot/package/python-pylast/Config.in
```kconfig
config BR2_PACKAGE_PYTHON_PYLAST
	bool "python-pylast"
	help
	  A Python interface to Last.fm and Libre.fm.

	  https://github.com/pylast/pylast
```

## buildroot/package/python-pymcuprog/Config.in
```kconfig
config BR2_PACKAGE_PYTHON_PYMCUPROG
	bool "python-pymcuprog"
	help
	  Python utility for programming various Microchip MCU devices

	  https://github.com/microchip-pic-avr-tools/pymcuprog

	select BR2_PACKAGE_PYTHON_PYEDBGLIB
	select BR2_PACKAGE_PYTHON_APPDIRS
	select BR2_PACKAGE_PYTHON_CYTHON
        select BR2_PACKAGE_PYTHON_PYYAML
	select BR2_PACKAGE_PYTHON_PYSERIAL
	select BR2_PACKAGE_PYTHON_INTELHEX
```

## buildroot/package/python-pyserial/Config.in
```kconfig
config BR2_PACKAGE_PYTHON_PYSERIAL
	bool "python-pyserial"
	help
	  Python Serial Port Extension.

	  https://github.com/pyserial/pyserial
```

## buildroot/package/python-pyupdi/Config.in
```kconfig
config BR2_PACKAGE_PYTHON_PYUPDI
	bool "python-pyupdi"
	help
	  An UPDI programming library

	  https://github.com/mraardvark/pyupdi
	select BR2_PACKAGE_PYTHON_PYSERIAL
	select BR2_PACKAGE_PYTHON_INTELHEX
#	select BR2_PACKAGE_PYTHON_PYLINT
```

## buildroot/package/python-rpigpio2/Config.in
```kconfig
config BR2_PACKAGE_PYTHON_RPIGPIO2
	bool "python-rpigpio2"
	depends on BR2_PACKAGE_PYTHON3
        select BR2_PACKAGE_PYTHON_GPIOD
	depends on !BR2_PACKAGE_PYTHON_PIGPIO
	help
	  RPi.GPIO2 is a library to control the GPIO on a Raspberry Pi.

	  https://github.com/underground-software/RPi.GPIO2
```

## buildroot/package/python-scramp/Config.in
```kconfig
config BR2_PACKAGE_PYTHON_SCRAMP
	bool "python-scramp"
	help
	  An implementation of the SCRAM protocol.

	  https://github.com/tlocke/scramp
```

## buildroot/package/python-tzupdate/Config.in
```kconfig
config BR2_PACKAGE_PYTHON_TZUPDATE
	bool "python-tzupdate"
	help
	  Set the system timezone based on IP geolocation.

	  https://github.com/cdown/tzupdate
```

## buildroot/package/python-uritools/Config.in
```kconfig
config BR2_PACKAGE_PYTHON_URITOOLS
	bool "python-uritools"
	help
		Python URI tools
```

## buildroot/package/python-usagedata/Config.in
```kconfig
config BR2_PACKAGE_PYTHON_USAGEDATA
	bool "python-usagedata"
        help
	  A simple data collector that keeps historical date in RAM
        depends on BR2_PACKAGE_PYTHON3
        depends on BR2_PACKAGE_HIFIBERRY_BASE
        select BR2_PACKAGE_PYTHON_BOTTLE
```

## buildroot/package/python-validictory/Config.in
```kconfig
config BR2_PACKAGE_PYTHON_VALIDICTORY
	bool "python-validictory"
	help
	  general purpose python data validator.

	  http://github.com/jamesturk/validictory
```

## buildroot/package/python-wheel/Config.in
```kconfig
config BR2_PACKAGE_PYTHON_WHEEL
	bool "python-wheel"
	help
	  Tool for Python wheels

	  http://pythonhosted.org/wheel/
```

## buildroot/package/python-wisa/Config.in
```kconfig
config BR2_PACKAGE_PYTHON_WISA
	bool "python-wisa"
	select BR2_PACKAGE_PYTHON_PG8000 # runtime
	select BR2_PACKAGE_PYTHON_SCRAMP # runtime
	select BR2_PACKAGE_PYTHON_BLINKER # runtime
	select BR2_PACKAGE_PYTHON_TERMCOLOR # runtime
	select BR2_PACKAGE_PYTHON_WHEEL # runtime
	help
	  A set Python modules and tools for controlling Summit Semiconductor's
	  WiSA TX and RX modules

	  http://github.com/j-schambacher/wisa-summit
```

## buildroot/package/python-youtube-dl/Config.in
```kconfig
config BR2_PACKAGE_PYTHON_YOUTUBE_DL
	bool "python-youtube-dl"
	help
	  YouTube video downloader.

	  https://github.com/ytdl-org/youtube-dl
```

## buildroot/package/python-zopeevent/Config.in
```kconfig
config BR2_PACKAGE_PYTHON_ZOPEEVENT
	bool "python-zopeevent"
	select BR2_PACKAGE_PYTHON_SETUPTOOLS # runtime
	help
	  Very basic event publishing system.

	  https://github.com/zopefoundation/zope.event
```

## buildroot/package/python-zopeinterface/Config.in
```kconfig
config BR2_PACKAGE_PYTHON_ZOPEINTERFACE
	bool "python-zopeinterface"
	select BR2_PACKAGE_PYTHON_SETUPTOOLS # runtime
	help
	  Interfaces for Python.

	  https://github.com/zopefoundation/zope.interface
```

## buildroot/package/raspi-wifi/Config.in
```kconfig
config BR2_PACKAGE_RASPI_WIFI
	bool "raspi-wifi"
        help
	  Add WiFi support and configuration of WiFi using a 
          temporary access point

	select BR2_PACKAGE_DNSMASQ
	select BR2_PACKAGE_DNSMASQ_DHCP
	select BR2_PACKAGE_HOSTAPD
	select BR2_PACKAGE_HOSTAPD_DRIVER_HOSTAP
	select BR2_PACKAGE_HOSTAPD_DRIVER_NL80211
	select BR2_PACKAGE_HOSTAPD_HAS_WIFI_DRIVER
	select BR2_PACKAGE_HOSTAPD_DRIVER_NL80211
	select BR2_PACKAGE_HOSTAPD_HAS_WIFI_DRIVERS
	select BR2_PACKAGE_HOSTAPD_ACS
	select BR2_PACKAGE_HOSTAPD_EAP
	select BR2_PACKAGE_CRDA
	select BR2_PACKAGE_WIRELESS_TOOLS
        select BR2_PACKAGE_WPA_SUPPLICANT
        select BR2_PACKAGE_WPA_SUPPLICANT_NL80211
        select BR2_PACKAGE_WPA_SUPPLICANT_AP_SUPPORT
        select BR2_PACKAGE_WPA_SUPPLICANT_WIFI_DISPLAY
        select BR2_PACKAGE_WPA_SUPPLICANT_MESH_NETWORKING
        select BR2_PACKAGE_WPA_SUPPLICANT_AUTOSCAN
        select BR2_PACKAGE_WPA_SUPPLICANT_EAP
        select BR2_PACKAGE_WPA_SUPPLICANT_HOTSPOT
        select BR2_PACKAGE_WPA_SUPPLICANT_DEBUG_SYSLOG
        select BR2_PACKAGE_WPA_SUPPLICANT_WPS
        select BR2_PACKAGE_WPA_SUPPLICANT_CLI
        select BR2_PACKAGE_WPA_SUPPLICANT_WPA_CLIENT_SO
        select BR2_PACKAGE_WPA_SUPPLICANT_PASSPHRASE
        select BR2_PACKAGE_WPA_SUPPLICANT_DBUS
        select BR2_PACKAGE_WPA_SUPPLICANT_DBUS_INTROSPECTION
	select BR2_PACKAGE_WIRELESS_TOOLS_LIB
	select BR2_PACKAGE_WPA_SUPPLICANT_WPA3
```

## buildroot/package/roonbridge/Config.in
```kconfig
config BR2_PACKAGE_ROONBRIDGE
	bool "roonbridge"
        help
	  Roon network audio player
```

## buildroot/package/smbtools/Config.in
```kconfig
config BR2_PACKAGE_SMBTOOLS
	bool "smbtools"
	help
	  Tools to work with Samba shares
        select BR2_PACKAGE_CIFS_UTILS
```

## buildroot/package/snapcast/Config.in
```kconfig
# from https://github.com/badaix/snapos

config BR2_PACKAGE_SNAPCAST
	bool "Snapcast"
	depends on BR2_USE_MMU # avahi
	depends on !BR2_STATIC_LIBS # avahi
	depends on BR2_TOOLCHAIN_HAS_THREADS
	depends on BR2_INSTALL_LIBSTDCPP
	select BR2_PACKAGE_AVAHI
	select BR2_PACKAGE_AVAHI_DAEMON
	select BR2_PACKAGE_BOOST
	select BR2_PACKAGE_DBUS
	select BR2_PACKAGE_FLAC
	select BR2_PACKAGE_LIBVORBIS
	help
	  Synchronous multi-room audio player
	  
	  https://github.com/badaix/snapcast

if BR2_PACKAGE_SNAPCAST

config BR2_PACKAGE_SNAPCAST_CLIENT
	bool "Snapclient"
	default y
	help
	  Snapcast client

config BR2_PACKAGE_SNAPCAST_SERVER
	bool "Snapserver"
	help
	  Snapcast server

endif

comment "Snapcast needs a toolchain w/ C++, threads, dynamic library"
	depends on BR2_USE_MMU
	depends on !BR2_INSTALL_LIBSTDCPP || !BR2_TOOLCHAIN_HAS_THREADS \
		|| BR2_STATIC_LIBS
```

## buildroot/package/snapcastmpris/Config.in
```kconfig
config BR2_PACKAGE_SNAPCASTMPRIS
	bool "snapcastmpris"
        help
	  "MPRIS interface for Snapcast client"
        select BR2_PACKAGE_DBUS
	select BR2_PACKAGE_DBUS_PYTHON
        select BR2_PACKAGE_PYTHON_NETIFACES
	select BR2_PACKAGE_PYTHON_REQUESTS
	select BR2_PACKAGE_PYTHON_ZEROCONF
	select BR2_PACKAGE_PYTHON_WEBSOCKET_CLIENT
        depends on BR2_PACKAGE_SNAPCAST_CLIENT
```

## buildroot/package/spotifyd-src/Config.in
```kconfig
config BR2_PACKAGE_SPOTIFYD_SRC
	bool "spotifyd from source"
        help
	  An open source Spotify client running as a UNIX daemon. 
        select BR2_PACKAGE_HOST_CARGO
	select BR2_PACKAGE_HOST_RUSTC
```

## buildroot/package/spotifyd/Config.in
```kconfig
config BR2_PACKAGE_SPOTIFYD
	bool "spotifyd"
        help
	  An open source Spotify client running as a UNIX daemon. 
        depends on BR2_PACKAGE_HIFIBERRY_BASE
#        select BR2_PACKAGE_HOST_CARGO
#	select BR2_PACKAGE_HOST_RUSTC
```

## buildroot/package/vollibrespot/Config.in
```kconfig
config BR2_PACKAGE_VOLLIBRESPOT
	bool "vollibrespot"
        help
	  An open source Spotify player with a metadata interface
        select BR2_PACKAGE_HOST_CARGO
	select BR2_PACKAGE_HOST_RUSTC
```

## buildroot/package/watchdog/Config.in
```kconfig
config BR2_PACKAGE_WATCHDOG
	bool "watchdog"
        help
	   Simple watchdog daemon that will reset the system when it hangs
```
